## bossac/Config.in
```kconfig
config BR2_PACKAGE_BOSSAC
	bool "bossac"
	select BR2_PACKAGE_ELFUTILS
	select BR2_PACKAGE_LIBUSB
	select BR2_PACKAGE_LIBUSB_COMPAT
	select BR2_PACKAGE_NCURSES
	depends on BR2_TOOLCHAIN_HAS_THREADS
	depends on BR2_USE_WCHAR # elfutils
	depends on !BR2_STATIC_LIBS # elfutils
	depends on !BR2_bfin # elfutils
	help
	  bossac is a programmer for Atmel ARM microcontrollers with SAM-BA bootloader
	  https://github.com/shumatech/BOSSA.git

comment "bossac needs a toolchain w/ threads, wchar, dynamic library"
	depends on !BR2_TOOLCHAIN_HAS_THREADS || !BR2_USE_WCHAR || BR2_STATIC_LIBS
	depends on !BR2_bfin
```
